## esp_hum/sdkconfig.defaults
```kconfig
CONFIG_BT_ENABLED=y
CONFIG_BT_BLUEDROID_ENABLED=y
CONFIG_BT_NIMBLE_ENABLED=n
CONFIG_BT_BLUFI_ENABLED=n
CONFIG_PARTITION_TABLE_CUSTOM=y
CONFIG_PARTITION_TABLE_CUSTOM_FILENAME="partitions_2MB.csv"
CONFIG_PARTITION_TABLE_FILENAME="partitions_2MB.csv"
CONFIG_PARTITION_TABLE_OFFSET=0x8000
```
